## CMakeLists.txt
```
cmake_minimum_required(VERSION 3.20.0)
find_package(Zephyr REQUIRED HINTS $ENV{ZEPHYR_BASE})

project(ProjectRTOSNikolai)

target_sources(app PRIVATE src/main.c src/lsm303_ll.c src/matrix.c) 
```

## prj.conf
```kconfig
CONFIG_PRINTK=y
CONFIG_DISPLAY=y
CONFIG_NRFX_TIMER0=y
CONFIG_NRFX_TIMER1=y
CONFIG_TIMING_FUNCTIONS=y
```

## src/main.c
```c
/*
 * Copyright (c) 2017 Linaro Limited
 *
 * SPDX-License-Identifier: Apache-2.0
 * 
 * By Nikolai Eidheim
 * 
 * Based on code from docs.zephyrproject.org and Steven Bos's github code: 
 * https://github.com/aiunderstand/Real-TimeOS-with-Microbit-nRF52833
 */

#include <zephyr/kernel.h>
#include <zephyr/sys/printk.h>
#include "lsm303_ll.h"
#include "matrix.h"
#include <stdbool.h>
#include <nrfx_timer.h>
#include <zephyr/timing/timing.h>

// thread initialization
#define STACKSIZE 1024
#define THREAD0_PRIORITY 5 // higest priority
#define THREAD1_PRIORITY 6

// global timer initialization
#define TIME_TO_WAIT_MS 5000UL // 5 seconds
#define TIMER_INST_IDX 0
nrfx_timer_t timer_inst = NRFX_TIMER_INSTANCE(TIMER_INST_IDX);

// message queue initialization
int msgQueue[3] = {0};
K_MSGQ_DEFINE(my_msgq, sizeof(msgQueue), 1, 4); 

// toggle counter for display patterns
int counter = 0;

// Status variables used for logic
int HasTilted = 0;
int Tiltstatus = 0;
int CriticalThresholdReached = 0;
int makeCheck = 0;

// interupt function for when the timer is done
static void timer_handler(nrf_timer_event_t event_type, void * p_context)
{
	makeCheck = 1;
}

// initialize the program
int main(void)
{
	int ret;
	ret = lsm303_ll_begin();        
	if (ret < 0)
	{
		printk("\nError initializing lsm303.  Error code = %d\n",ret);	
		while(1);
	}
	int ret2;
	ret2 = matrix_begin();
	if (ret2 < 0)
	{
		printk("\nError initializing LED matrix.  Error code = %d\n",ret2);	
		while(1);
	}

	// initialize the timer

	#if defined(__ZEPHYR__)
    	IRQ_CONNECT(NRFX_IRQ_NUMBER_GET(NRF_TIMER_INST_GET(TIMER_INST_IDX)), IRQ_PRIO_LOWEST,
                NRFX_TIMER_INST_HANDLER_GET(TIMER_INST_IDX), 0, 0);
	#endif
	
 	uint32_t base_frequency = NRF_TIMER_BASE_FREQUENCY_GET(timer_inst.p_reg);
    nrfx_timer_config_t config = NRFX_TIMER_DEFAULT_CONFIG(base_frequency);
    config.bit_width = NRF_TIMER_BIT_WIDTH_32;
    config.p_context = "My context";

    nrfx_err_t status = nrfx_timer_init(&timer_inst, &config, timer_handler);
    NRFX_ASSERT(status == NRFX_SUCCESS);
	

	nrfx_timer_clear(&timer_inst);

    /* Creating variable desired_ticks to store the output of nrfx_timer_ms_to_ticks function */
    uint32_t desired_ticks = nrfx_timer_ms_to_ticks(&timer_inst, TIME_TO_WAIT_MS);
    
    /*
     * Setting the timer channel NRF_TIMER_CC_CHANNEL0 in the extended compare mode to stop the timer and
     * trigger an interrupt if internal counter register is equal to desired_ticks.
     */
    nrfx_timer_extended_compare(&timer_inst, NRF_TIMER_CC_CHANNEL0, desired_ticks,
                                NRF_TIMER_SHORT_COMPARE0_STOP_MASK, true);

}

void thread0(void)
{
	while (1) {
		// if Critical Threshold Reached, do nothing
		if (CriticalThresholdReached == 1) {
			return;
		}

		// read data from accelerometer
		struct All_Axes_Data data = lsm303_ll_readAccel();

		// put the data in the message queue array
		msgQueue[0] = data.X;
		msgQueue[1] = data.Y;
		msgQueue[2] = data.Z;


		// Put a message in the message queue. If the message queue is full, purge messages.
        while (k_msgq_put(&my_msgq, &msgQueue, K_NO_WAIT) != 0) {
            /* message queue is full: purge old data & try again */
            k_msgq_purge(&my_msgq);
        }


		// sleep for 3ms, which is the period
		k_msleep(9);
	}
}

void thread1(void)
{
	while (1) {

		// to check time of execution
		/*
		timing_t start_time, end_time;
		uint64_t total_cycles;
		uint64_t total_ns;

		timing_init();
		timing_start();

		start_time = timing_counter_get();
		*/


		// array to store the data from the message queue
		int ReceivedData[3] = {0};

		// checks state after 5 seconds
		if (makeCheck == 1) {
			makeCheck = 0;
			if (Tiltstatus == 1) {
				CriticalThresholdReached = 1;
			}
			else {
				HasTilted = 0;
				nrfx_timer_clear(&timer_inst);
			}
		}

		// if Critical Threshold Reached, do nothing
		if (CriticalThresholdReached == 1) {
				// critical warning leds, all leds on
				matrix_put_pattern(31, 0);
				return;
		}

		// gets data from message queue
		k_msgq_get(&my_msgq, &ReceivedData, K_FOREVER);


		// print the data to the monitor, debugging purpose
		printk("X %d\n", ReceivedData[0]);
		printk("Y = %d\n", ReceivedData[1]);
		printk("Z = %d\n", ReceivedData[2]);	  

		// Check if msgQueue[0] or msgQueue[1], X or Y, is above or below +-500
		if (ReceivedData[0] > 500 || ReceivedData[0] < -500 || ReceivedData[1] > 500 || ReceivedData[1] < -500) {
			Tiltstatus = 1;
			// led for current tilt status
			if (counter == 2)
				matrix_put_pattern(4, 27);		
			if (HasTilted == 0) {
				nrfx_timer_enable(&timer_inst);
				HasTilted = 1;
			}
		}
		else {
			Tiltstatus = 0;
			matrix_all_off();
		}
		// led for warning state
		if (counter == 0 && HasTilted == 1) {
			matrix_put_pattern(17, 0);
		} else if (counter == 1 && HasTilted == 1) {
			matrix_put_pattern(14, 14);
		}

		// counter for toggling leds to allow more leds settings at the same time
		counter++;
		counter = counter%3;






		// to check time of execution		
		/*
		end_time = timing_counter_get();
    	total_cycles = timing_cycles_get(&start_time, &end_time);
    	total_ns = timing_cycles_to_ns(total_cycles);
    	timing_stop();
		printf("ns: %llu\n", total_ns);
		*/

		// sleep for 3ms, which is the period
		k_msleep(10);

	}
}

// define the threads
K_THREAD_DEFINE(thread0_id, STACKSIZE, thread0, NULL, NULL, NULL,
		THREAD0_PRIORITY, 0, 0);
K_THREAD_DEFINE(thread1_id, STACKSIZE, thread1, NULL, NULL, NULL,
		THREAD1_PRIORITY, 0, 0);
```

## src/lsm303_ll.c
```c
#include <zephyr/sys/printk.h>
#include <zephyr/drivers/gpio.h>
#include <zephyr/drivers/i2c.h>
#include "lsm303_ll.h"

int lsm303_ll_readRegister(uint8_t RegNum, uint8_t *Value);
int lsm303_ll_writeRegister(uint8_t RegNum, uint8_t Value);
void readCalibrationData();
//static const struct spi_config * cfg;
static const struct device *i2c;
int lsm303_ll_begin()
{
	int nack;
	uint8_t device_id;
	// Set up the I2C interface
	i2c=DEVICE_DT_GET(DT_NODELABEL(i2c0));	
	if (i2c==NULL)
	{
		printf("Error acquiring i2c0 interface (internal) \n");
		return -1;
	}	
	// Check to make sure the device is present by reading the WHO_AM_I register
	
    nack = lsm303_ll_readRegister(0x0f,&device_id);
    if (nack != 0)
	{
		printf("Error finding LSM303 on the I2C bus\n");
		return -2;
	}
	else	
	{
		printf("Found LSM303.  WHO_AM_I = %d\n",device_id);
	}
	lsm303_ll_writeRegister(0x20,0x77); //wake up LSM303 (max speed, all accel channels)i2c_reg_read_byte
	lsm303_ll_writeRegister(0x23,0x08); //enable  high resolution mode +/- 2g
	
	return 0;
}

struct All_Axes_Data lsm303_ll_readAccel() // returns Temperature * 100
{
	uint8_t buf[6];	
	i2c_burst_read(i2c,LSM303_ACCEL_ADDRESS,0xa8, buf,6);
	
	struct All_Axes_Data data;   
	data.X = Convert(buf[0],buf[1]); 
	data.Y = Convert(buf[2],buf[3]); 
	data.Z = Convert(buf[4],buf[5]);
	return data;
}

int Convert (int8_t H, int8_t L) {
    int16_t accel;
	
	accel = L;
	accel = accel << 8;
	accel = accel + H;
	accel = accel / 16; // must shift right 4 bits as this is a left justified 12 bit result
	// now scale to m^3/s * 100.
	// +2047 = +2g
	int accel_32bit = accel; // go to be wary of numeric overflow
	accel_32bit = accel_32bit * 2*981 / 2047;
    return accel_32bit;
}

int lsm303_ll_readRegister(uint8_t RegNum, uint8_t *Value)
{
	    //reads a byte from a specific register
    int nack;   
	nack=i2c_reg_read_byte(i2c,LSM303_ACCEL_ADDRESS,RegNum,Value);
	return nack;
}
int lsm303_ll_writeRegister(uint8_t RegNum, uint8_t Value)
{
	//writes a byte to a specific register
    uint8_t Buffer[2];    
    Buffer[0]= Value;    
    int nack;    
	nack=i2c_reg_write_byte(i2c,LSM303_ACCEL_ADDRESS,RegNum,Value);
    return nack;
}
```

## src/lsm303_ll.h
```c
#ifndef __bmp280_h
#define __bmp280_h
#define LSM303_ACCEL_ADDRESS (0x19)

struct All_Axes_Data
  {
     int X,Y,Z;
  };

int lsm303_ll_begin();
int Convert (int8_t H, int8_t L);
struct All_Axes_Data lsm303_ll_readAccel();
#endif
```

## src/matrix.c
```c
//Adapted from: 
//https://github.com/fduignan/zephyr_bbc_microbit_v2/tree/main/zephyr_3.1.0/led_matrix/src

//Note:
//This driver is rather simple. Some LED patterns cannot be displayed without the concept of 
//persistance of vision. Since we have 5 rows and 5 columns at least 5 cycles are needed to //display all possible LED patterns. 

//More advanced display drivers would have more cycles to control the brightness of individual pixels with PWM signals, see
//https://docs.broadcom.com/doc/AV02-3697EN or the implementation in Zephyr in
//https://github.com/zephyrproject-rtos/zephyr/blob/main/samples/boards/nrf/nrf_led_matrix/src/main.c
#include <zephyr/sys/printk.h>
#include <zephyr/drivers/gpio.h>
#include "matrix.h"
#define ROW1_PORT_BIT 21
#define ROW2_PORT_BIT 22
#define ROW3_PORT_BIT 15
#define ROW4_PORT_BIT 24
#define ROW5_PORT_BIT 19

#define COL1_PORT_BIT 28
#define COL2_PORT_BIT 11
#define COL3_PORT_BIT 31
#define COL4_PORT_BIT 5
#define COL5_PORT_BIT 30

static const struct device *gpio0, *gpio1;		
void set_row1(int state)
{
	gpio_pin_set(gpio0,ROW1_PORT_BIT,state);
}
void set_row2(int state)
{
	gpio_pin_set(gpio0,ROW2_PORT_BIT,state);
}
void set_row3(int state)
{
	gpio_pin_set(gpio0,ROW3_PORT_BIT,state);
}
void set_row4(int state)
{
	gpio_pin_set(gpio0,ROW4_PORT_BIT,state);
}
void set_row5(int state)
{
	gpio_pin_set(gpio0,ROW5_PORT_BIT,state);
}
void set_col1(int state)
{
	gpio_pin_set(gpio0,COL1_PORT_BIT,state);
}
void set_col2(int state)
{
	gpio_pin_set(gpio0,COL2_PORT_BIT,state);
}
void set_col3(int state)
{
	gpio_pin_set(gpio0,COL3_PORT_BIT,state);
}
void set_col4(int state)
{
	gpio_pin_set(gpio1,COL4_PORT_BIT,state);
}
void set_col5(int state)
{
	gpio_pin_set(gpio0,COL5_PORT_BIT,state);
}
int matrix_begin()
{
	int ret;
	// Configure the GPIO's 	
	gpio0=DEVICE_DT_GET(DT_NODELABEL(gpio0));
	if (gpio0 == NULL)
	{
		printf("Error acquiring GPIO 0 interface\n");
		return -1;
	}
	gpio1=DEVICE_DT_GET(DT_NODELABEL(gpio1));
	if (gpio0 == NULL)
	{
		printf("Error acquiring GPIO 1 interface\n");
 		return -2;
	}
	ret = gpio_pin_configure(gpio0,ROW1_PORT_BIT,GPIO_OUTPUT);
	ret = gpio_pin_configure(gpio0,ROW2_PORT_BIT,GPIO_OUTPUT);
	ret = gpio_pin_configure(gpio0,ROW3_PORT_BIT,GPIO_OUTPUT);
	ret = gpio_pin_configure(gpio0,ROW4_PORT_BIT,GPIO_OUTPUT);
	ret = gpio_pin_configure(gpio0,ROW5_PORT_BIT,GPIO_OUTPUT);
	
	ret = gpio_pin_configure(gpio0,COL1_PORT_BIT,GPIO_OUTPUT);
	ret = gpio_pin_configure(gpio0,COL2_PORT_BIT,GPIO_OUTPUT);
	ret = gpio_pin_configure(gpio0,COL3_PORT_BIT,GPIO_OUTPUT);
	ret = gpio_pin_configure(gpio1,COL4_PORT_BIT,GPIO_OUTPUT);
	ret = gpio_pin_configure(gpio0,COL5_PORT_BIT,GPIO_OUTPUT);
	
	matrix_all_off();	
	return 0;	
}
void matrix_put_pattern(uint8_t rows, uint8_t cols)
{
	set_row1(rows & 1);
	rows = rows >> 1;
	set_row2(rows & 1);
	rows = rows >> 1;
	set_row3(rows & 1);
	rows = rows >> 1;
	set_row4(rows & 1);
	rows = rows >> 1;
	set_row5(rows & 1);
	
	set_col1(cols & 1);
	cols = cols >> 1;
	set_col2(cols & 1);
	cols = cols >> 1;
	set_col3(cols & 1);
	cols = cols >> 1;
	set_col4(cols & 1);
	cols = cols >> 1;
	set_col5(cols & 1);
}
void matrix_all_off()
{
	set_row1(0);
	set_row2(0);
	set_row3(0);
	set_row4(0);
	set_row5(0);
	
	set_col1(1);
	set_col2(1);
	set_col3(1);
	set_col4(1);
	set_col5(1);
	
}
```

## src/matrix.h
```c
#ifndef __MATRIX_H
#define __MATRIX_H
int matrix_begin();
void matrix_all_off();
void matrix_put_pattern(uint8_t rows, uint8_t cols);
#endif
```
